/*
 * Copyright (c) 2019, Nordic Semiconductor ASA
 *
 * SPDX-License-Identifier: Apache-2.0
 */

#include <dt-bindings/gpio/gpio.h>

/ {
	led_strip: ws2812 {
		compatible = "worldsemi,ws2812-gpio";
		label = "WS2812";

		chain-length = <16>; /* arbitrary */
		/*
		 * Arduino A0 PA0 pin on stm32l432kc
		 */
		in-gpios = <&gpioa 0 GPIO_ACTIVE_HIGH>;
	};

	aliases {
		led-strip = &led_strip;
	};
};
