/*
 * Copyright (c) 2020 LOCHE Jeremy <lochejeremy@gmail.com>
 *
 * SPDX-License-Identifier: Apache-2.0
 */

&spi1 {
	status = "okay";
	pinctrl-0 = <&spi1_mosi_pa7 &spi1_sck_pa5 &spi1_miso_pa6>;
	cs-gpios = <&gpioa 11 GPIO_ACTIVE_LOW>;

	st7565fb@0 {
		compatible = "sitronix,st7565fb";
		label = "ST7565";
		spi-max-frequency = <16000000>;
		reg = <0>;
		width = <128>;
		height = <64>;
		reset-gpios = <&gpiob 4 GPIO_ACTIVE_LOW>;
		rs-gpios = <&gpiob 5 GPIO_ACTIVE_LOW>;
	};
};