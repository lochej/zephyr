## drivers/display/Kconfig.st7565
```kconfig
# ST7565 display controller configuration options

# Copyright (c) 2020 LOCHE Jeremy <lochejeremy@gmail.com>
# SPDX-License-Identifier: Apache-2.0

config ST7565
	bool "ST7565 compatible display controller driver"
	depends on SPI
	help
	  Enable driver for ST7565 compatible controller.
```

## drivers/led_strip/Kconfig.ws2812
```kconfig
# Copyright (c) 2017 Linaro Limited
# Copyright (c) 2019 Nordic Semiconductor ASA
#
# SPDX-License-Identifier: Apache-2.0

# The following blog post is an excellent resource about pulse timing:
#
# https://wp.josh.com/2014/05/13/ws2812-neopixels-are-not-so-finicky-once-you-get-to-know-them/

menuconfig WS2812_STRIP
	bool "Enable WS2812 (and compatible) LED strip driver"
	select LED_STRIP_RGB_SCRATCH
	help
	  Enable LED strip driver for daisy chains of WS2812-ish
	  (or WS2812B, WS2813, SK6812, or compatible) devices.

choice WS2812_STRIP_DRIVER
	prompt "Driver backend"
	default WS2812_STRIP_SPI
	depends on WS2812_STRIP

config WS2812_STRIP_SPI
	bool "Enable the SPI driver"
	depends on SPI
	help
	  The SPI driver is portable, but requires significantly more
	  memory (1 byte of overhead per bit of pixel data).

config WS2812_STRIP_GPIO
	bool "Enable the GPIO driver"
	# Only an Cortex-M0 inline assembly implementation for the nRF51
	# is supported currently.
	depends on SOC_SERIES_NRF51X || SOC_FAMILY_STM32
	help
	  The GPIO driver does bit-banging with inline assembly,
	  and is not available on all SoCs.

endchoice

config WS2812_STRIP_GPIO_CYCLES_T1H
	int "Number of CPU cycles corresponding to T1H timing"
	default 12
	depends on WS2812_STRIP_GPIO
	help
	  This value is used to generate NOP instruction to create delay
	  Compute this timing with your CPU frequency
	  T1H: nanoseconds for T1H timing
	  F_CPU: cpu frequency in Hz
	  Cycles = T1H * F_CPU / 1000000000
	  If your CPU has flash wait states, consider tweaking this value down

config WS2812_STRIP_GPIO_CYCLES_T1L
	int "Number of CPU cycles corresponding to T1L timing"
	default 8
	depends on WS2812_STRIP_GPIO
	help
	  This value is used to generate NOP instruction to create delay
	  Compute this timing with your CPU frequency
	  T1L: nanoseconds for T1L timing
	  F_CPU: cpu frequency in Hz
	  Cycles = T1L * F_CPU / 1000000000
	  If your CPU has flash wait states, consider tweaking this value down

config WS2812_STRIP_GPIO_CYCLES_T0H
	int "Number of CPU cycles corresponding to T0H timing"
	default 4
	depends on WS2812_STRIP_GPIO
	help
	  Compute this timing with your CPU frequency
	  T0H: nanoseconds for T0H timing
	  F_CPU: cpu frequency in Hz
	  Cycles = T0H * F_CPU / 1000000000

config WS2812_STRIP_GPIO_CYCLES_T0L
	int "Number of CPU cycles corresponding to T0L timing"
	default 8
	depends on WS2812_STRIP_GPIO
	help
	  Compute this timing with your CPU frequency
	  T0L: nanoseconds for T0L timing
	  F_CPU: cpu frequency in Hz
	  Cycles = T0L * F_CPU / 1000000000
```

## dts/bindings/display/sitronix,st7565.yaml
```yaml
# Copyright (c) 2020 LOCHE Jeremy <lochejeremy@gmail.com>
# SPDX-License-Identifier: Apache-2.0

description: ST7565 / ST7567 128x64 LCD display controller

compatible: "sitronix,st7565fb"

include: spi-device.yaml

properties:
    height:
      type: int
      required: true
      description: Height in pixel of the panel driven by the controller

    width:
      type: int
      required: true
      description: Width in pixel of the panel driven by the controller

    reset-gpios:
      type: phandle-array
      required: true
      description: RESET pin.

        The RESET pin of ST7565 is active low.
        If connected directly the MCU pin should be configured
        as active low.

    rs-gpios:
      type: phandle-array
      required: true
      description: RS/A0 pin.

        The RS/A0 pin of ST7565 selects command or data register.
        Use LOW for control data and HIGH for display data.

    bias:
      type: int
      required: false
      default: 0
      description: Bias setting of the controller.

        Use 0 for 1/9 bias and 1 for 1/7 bias.
        Select 1/9
          bias = <0>;
        Select 1/7
          bias = <1>;

    regulator-ratio:
      type: int
      required: false
      default: 6
      description: Regulator ratio setting of the controller.

        Value indicates value in the following list
        RR  Ratio
        0 = 3.0
        1 = 3.5
        2 = 4.0
        3 = 4.5
        4 = 5.0
        5 = 5.5
        6 = 6.0
        7 = 6.5

        i.e. for rr=2 4.0 ratio use
          regulator-ratio = <2>;

    ev-contrast-range:
      type: uint8-array
      required: false
      default: [0x10, 0x28]
      description: Electronic volume contrast adjustment range.

        Provide a range of contrast values from lowest to highest.
        Values are [minimum, maximum] for the ST7565 EV register
        which give lowest and highest desirable contrast.
        Contrast will be auto-adjusted to the middle value of this range.
        To fix contrast value, use the same for both min and max.
          ev-contrast-range = [3F 3F];
```

## samples/display/lvgl/boards/nucleo_l432kc.conf
```kconfig
CONFIG_SPI=y
CONFIG_ST7565=y

CONFIG_DISPLAY_LOG_LEVEL_DBG=y
CONFIG_LVGL_COLOR_DEPTH_1=y
CONFIG_LVGL_BITS_PER_PIXEL=1
CONFIG_LVGL_HOR_RES_MAX=128
CONFIG_LVGL_VER_RES_MAX=64
CONFIG_LVGL_DPI=49
CONFIG_LVGL_VDB_SIZE=16
```

## samples/drivers/led_ws2812/boards/nucleo_h743zi.conf
```kconfig
CONFIG_SPI=n
CONFIG_WS2812_STRIP_GPIO=y

#F_CPU = 96 Mhz
CONFIG_WS2812_STRIP_GPIO_CYCLES_T1H=77
CONFIG_WS2812_STRIP_GPIO_CYCLES_T1L=43
CONFIG_WS2812_STRIP_GPIO_CYCLES_T0H=39
CONFIG_WS2812_STRIP_GPIO_CYCLES_T0L=81

#F_CPU = 480 Mhz
#CONFIG_WS2812_STRIP_GPIO_CYCLES_T1H=384
#CONFIG_WS2812_STRIP_GPIO_CYCLES_T1L=216
#CONFIG_WS2812_STRIP_GPIO_CYCLES_T0H=192
#CONFIG_WS2812_STRIP_GPIO_CYCLES_T0L=408

#F_CPU = 400 Mhz
#CONFIG_WS2812_STRIP_GPIO_CYCLES_T1H=320
#CONFIG_WS2812_STRIP_GPIO_CYCLES_T1L=180
#CONFIG_WS2812_STRIP_GPIO_CYCLES_T0H=160
#CONFIG_WS2812_STRIP_GPIO_CYCLES_T0L=340

#F_CPU = 120 Mhz
#CONFIG_WS2812_STRIP_GPIO_CYCLES_T1H=96
#CONFIG_WS2812_STRIP_GPIO_CYCLES_T1L=54
#CONFIG_WS2812_STRIP_GPIO_CYCLES_T0H=48
#CONFIG_WS2812_STRIP_GPIO_CYCLES_T0L=102

#F_CPU = 80 Mhz
#CONFIG_WS2812_STRIP_GPIO_CYCLES_T1H=64
#CONFIG_WS2812_STRIP_GPIO_CYCLES_T1L=36
#CONFIG_WS2812_STRIP_GPIO_CYCLES_T0H=32
#CONFIG_WS2812_STRIP_GPIO_CYCLES_T0L=68

#F_CPU = 40 Mhz
#CONFIG_WS2812_STRIP_GPIO_CYCLES_T1H=32
#CONFIG_WS2812_STRIP_GPIO_CYCLES_T1L=18
#CONFIG_WS2812_STRIP_GPIO_CYCLES_T0H=16
#CONFIG_WS2812_STRIP_GPIO_CYCLES_T0L=34

#F_CPU = 64MHz
CONFIG_WS2812_STRIP_GPIO_CYCLES_T1H=50
CONFIG_WS2812_STRIP_GPIO_CYCLES_T1L=27
CONFIG_WS2812_STRIP_GPIO_CYCLES_T0H=23
CONFIG_WS2812_STRIP_GPIO_CYCLES_T0L=51

#F_CPU = 32MHz
#CONFIG_WS2812_STRIP_GPIO_CYCLES_T1H=25
#CONFIG_WS2812_STRIP_GPIO_CYCLES_T1L=14
#CONFIG_WS2812_STRIP_GPIO_CYCLES_T0H=12
#CONFIG_WS2812_STRIP_GPIO_CYCLES_T0L=26

#F_CPU = 16MHz
#CONFIG_WS2812_STRIP_GPIO_CYCLES_T1H=6
#CONFIG_WS2812_STRIP_GPIO_CYCLES_T1L=3
#CONFIG_WS2812_STRIP_GPIO_CYCLES_T0H=3
#CONFIG_WS2812_STRIP_GPIO_CYCLES_T0L=6

#F_CPU = 8MHz
#CONFIG_WS2812_STRIP_GPIO_CYCLES_T1H=6
#CONFIG_WS2812_STRIP_GPIO_CYCLES_T1L=3
#CONFIG_WS2812_STRIP_GPIO_CYCLES_T0H=3
#CONFIG_WS2812_STRIP_GPIO_CYCLES_T0L=6
```

## samples/drivers/led_ws2812/boards/nucleo_l073rz.conf
```kconfig
CONFIG_SPI=n
CONFIG_WS2812_STRIP_GPIO=y

#F_CPU = 32MHz
#STM32L073 for 32MHz has 1 wait state
#ws=1 we use T*F_CPU/2
CONFIG_WS2812_STRIP_GPIO_CYCLES_T1H=13
CONFIG_WS2812_STRIP_GPIO_CYCLES_T1L=7
CONFIG_WS2812_STRIP_GPIO_CYCLES_T0H=6
CONFIG_WS2812_STRIP_GPIO_CYCLES_T0L=13

#F_CPU = 16MHz
#STM32L073 for 16MHz has 1 wait state
#ws=1 we use T*F_CPU/2
#CONFIG_WS2812_STRIP_GPIO_CYCLES_T1H=6
#CONFIG_WS2812_STRIP_GPIO_CYCLES_T1L=3
#CONFIG_WS2812_STRIP_GPIO_CYCLES_T0H=3
#CONFIG_WS2812_STRIP_GPIO_CYCLES_T0L=6

#F_CPU = 8MHz
#STM32L073 for 8MHz has 1 wait state
#ws=0 we use T*F_CPU
#CONFIG_WS2812_STRIP_GPIO_CYCLES_T1H=6
#CONFIG_WS2812_STRIP_GPIO_CYCLES_T1L=3
#CONFIG_WS2812_STRIP_GPIO_CYCLES_T0H=3
#CONFIG_WS2812_STRIP_GPIO_CYCLES_T0L=6
```

## samples/drivers/led_ws2812/boards/nucleo_l432kc.conf
```kconfig
CONFIG_SPI=n
CONFIG_WS2812_STRIP_GPIO=y

#F_CPU = 80MHz
#STM32L432KC
CONFIG_WS2812_STRIP_GPIO_CYCLES_T1H=64
CONFIG_WS2812_STRIP_GPIO_CYCLES_T1L=36
CONFIG_WS2812_STRIP_GPIO_CYCLES_T0H=32
CONFIG_WS2812_STRIP_GPIO_CYCLES_T0L=68

#Alternative CPU frequencies example
#F_CPU = 40MHz
#STM32L432KC
#CONFIG_WS2812_STRIP_GPIO_CYCLES_T1H=32
#CONFIG_WS2812_STRIP_GPIO_CYCLES_T1L=18
#CONFIG_WS2812_STRIP_GPIO_CYCLES_T0H=16
#CONFIG_WS2812_STRIP_GPIO_CYCLES_T0L=34
```
